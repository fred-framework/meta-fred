/dts-v1/;
/plugin/;
/ {
	fragment@0 {
		target = <&amba>;
		overlay3: __overlay__ {    
            slot_p0_s0@A0000000 { 
                    compatible = "generic-uio";
                    reg = <0x0 0xA0000000 0x0 0x10000>;
                    interrupt-parent = <&gic>;
                    interrupts = <0 89 4>;
                }; 

            pr_decoupler_p0_s0@A0010000 { 
                    compatible = "generic-uio";
                    reg = <0x0 0xA0010000 0x0 0x10000>;            
                }; 
        };
    };
};