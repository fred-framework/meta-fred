## conf/layer.conf
```bitbake
# We have a conf and classes directory, add to BBPATH
BBPATH .= ":${LAYERDIR}"

# We have recipes-* directories, add to BBFILES
BBFILES += "${LAYERDIR}/recipes-*/*/*.bb \
            ${LAYERDIR}/recipes-*/*/*.bbappend"

BBFILE_COLLECTIONS += "meta-fred"
BBFILE_PATTERN_meta-fred = "^${LAYERDIR}/"
BBFILE_PRIORITY_meta-fred = "7"

LAYERDEPENDS_meta-fred = "core"
LAYERSERIES_COMPAT_meta-fred = "zeus"

# FRED related libs and apps
IMAGE_INSTALL_append = " fred-lib"
IMAGE_INSTALL_append = " fred-tutorial"
IMAGE_INSTALL_append = " sum-vec"
IMAGE_INSTALL_append = " fred-server"


# one type of contitional assignment. Meaning, if the variable MACHINE includes the substr zynqmp, then the 1st value is assigned
# See example in https://embeddedguruji.blogspot.com/2019/03/bbutilscontains-yocto.html
#FPGA_MGR_MOD ?= '${@oe.utils.conditional("MACHINE", "zynqmp", "fpga-mgr-zynqmp-drv", "fpga-mgr-zynq-drv", d)}'

# learn more about conditional assignment with OVERRIDES in 
# https://www.yoctoproject.org/docs/current/bitbake-user-manual/bitbake-user-manual.html#conditional-syntax-overrides
OVERRIDES = "zynqmp-generic:ultra96-zynqmp:zcu102-zynqmp:zynq-generic"
# default value
FPGA_MGR_MOD = "fpga-mgr-zynqmp-drv"
FPGA_MGR_MOD_zynq-generic = "fpga-mgr-zynq-drv"

# FRED kernel modules
MACHINE_EXTRA_RDEPENDS += "fred-buffctl"
MACHINE_EXTRA_RDEPENDS += "${FPGA_MGR_MOD}"
IMAGE_INSTALL_append = " fred-buffctl"
IMAGE_INSTALL_append = " ${FPGA_MGR_MOD}"

# recommended tools. dtc is required to apply devicetree overlays in runtime
IMAGE_INSTALL_append = " tree dtc nano"

# post-processing functions: deploy_manifest, patch_pcap_devicetree
# see ./classes/post-process.bbclass
INHERIT += "post-process"

# FRED requires fpga-manager
# By default it will pack base hdf Bitstream and dtbo to the /lib/firmware/base in the rootfs
# https://xilinx-wiki.atlassian.net/wiki/spaces/A/pages/18841847/Solution+ZynqMP+PL+Programming
EXTRA_IMAGE_FEATURES += " fpga-manager"

# including package management feature
EXTRA_IMAGE_FEATURES += " package-management "
PACKAGE_FEED_URIS = "http://192.168.17.191:8000"
```
